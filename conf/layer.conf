## conf/layer.conf
```bitbake
# We have a conf and classes directory, add to BBPATH
BBPATH .= ":${LAYERDIR}"

# We have recipes-* directories, add to BBFILES
BBFILES += "${LAYERDIR}/recipes-*/*/*.bb \
            ${LAYERDIR}/recipes-*/*/*.bbappend"

BBFILE_COLLECTIONS += "meta-mistysom"
BBFILE_PATTERN_meta-mistysom = "^${LAYERDIR}/"
BBFILE_PRIORITY_meta-mistysom = "3"

LAYERDEPENDS_meta-mistysom = "core"
LAYERSERIES_COMPAT_meta-mistysom = "dunfell"
```
